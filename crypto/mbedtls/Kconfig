## crypto/mbedtls/Kconfig
```kconfig
# SPDX-License-Identifier: GPL-2.0-only
menuconfig MBEDTLS
	bool "Mbed TLS"
	help
	  Add comprehensive crypto support via the Mbed TLS library.

if MBEDTLS

config MBEDTLS_NEEDS_LIB_TLS
	bool
	help
	  This should be selected by any and all features that depends
	  on libmbedtls.a being linked in to barebox

config MBEDTLS_NEEDS_LIB_X509
	bool
	help
	  This should be selected by any and all features that depends
	  on libmbedx509.a being linked in to barebox

config MBEDTLS_SRC
	string "Source location"
	default "$(srctree)/../mbedtls"
	help
	  Path to a local directory containing the Mbed TLS sources.

config MBEDTLS_PKCS7
	bool "PKCS#7 Signature Validation"
	select MBEDTLS_NEEDS_LIB_X509
	help
	  Support validating PKCS#7 signatures against X509
	  certificates.

endif
```

## drivers/block/dm/Kconfig
```kconfig
menuconfig DM_BLK
	bool "Device mapper"
	help
	  Composable virtual block devices made up of mappings to
	  other data sources. Modeled after, and intended to be
	  compatible with, the Linux kernel's device mapper subsystem.

config DM_BLK_LINEAR
	bool "Linear target"
	depends on DM_BLK
	help
	  Maps a contiguous region of an existing device into a dm
	  device.

config DM_BLK_VERITY
	bool "Verity target"
	depends on DM_BLK
	help
	  Transparent integrity checking of underlying device using a
	  pre-computed Merkle tree.

config DM_BLK_VERITY_SIG
	bool "Support validation of UAPI DPS verity signatures"
	depends on DM_BLK_VERITY
	select BASE64
	select CRYPTO_BUILTIN_KEYS
	select JSMN
	default y
	help
	  Enable support for validating dm-verity signatures according to
	  the UAPI Group's Discoverable Partitions Specification (DPS).
	  This allows verification of dm-verity root hashes using
	  cryptographic signatures embedded in partition metadata.

	  The DPS verity signature format provides a standardized way to
	  associate cryptographic signatures with dm-verity protected
	  partitions, enabling secure boot scenarios where partition
	  integrity must be cryptographically verified.
```
